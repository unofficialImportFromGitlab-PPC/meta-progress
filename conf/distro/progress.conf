## conf/distro/progress.conf
```bitbake
# Copyright (c) 2017 Power Progress Community

require conf/distro/poky.conf

DISTRO = "progress"
DISTRO_NAME = "Power Progress Linux"
DISTRO_VERSION = "0.6"
SDK_VENDOR = "-progresssdk"
SDK_VERSION := "${@'${DISTRO_VERSION}'.replace('snapshot-${DATE}','snapshot')}"


MAINTAINER = "Progress <progress@powerprogress.org>"

DISTRO_FEATURES += " pam x11 keyboard usbgadget usbhost wifi opengl dircertfb"
```

## conf/layer.conf
```bitbake
# We have a conf and classes directory, add to BBPATH
BBPATH .= ":${LAYERDIR}"

# We have recipes-* directories, add to BBFILES
BBFILES += "${LAYERDIR}/recipes-*/*/*.bb  ${LAYERDIR}/recipes-*/*/*/*.bb ${LAYERDIR}/recipes-*/*/*/*/*.bb \
	${LAYERDIR}/recipes-*/*/*.bbappend"
	
BBFILES += "${LAYERDIR}/extends-*/*.bb ${LAYERDIR}/extends-*/*.bbappend"	

BBFILE_COLLECTIONS += "progress"
BBFILE_PATTERN_progress = "^${LAYERDIR}/"
BBFILE_PRIORITY_progress = "25"
```
